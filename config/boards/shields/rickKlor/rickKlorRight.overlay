#include "rickKlorRight-layouts.dtsi"
#include <dt-bindings/zmk/matrix_transform.h>
#include <dt-bindings/pinctrl/nrf-pinctrl.h>



&{/chosen} {
    zmk,kscan = &kscan_comp;
};

/ {
    kscan_comp: kscan_comp {
        compatible = "zmk,kscan-composite";
        label = "COMPOSITE_KSCAN";
        kscan = <&kscan0>, <&kscan_extra>;
    };
};

/ {
    // Additional GPIO direct keys for 5-way switch
    kscan_extra: kscan_extra {
        compatible = "zmk,kscan-gpio-direct";
        label = "EXTRA_KEYS";
        
        input-gpios
            = <&pro_micro 0 (GPIO_ACTIVE_LOW | GPIO_PULL_UP)>    // up
            , <&pro_micro 14 (GPIO_ACTIVE_LOW | GPIO_PULL_UP)>   // down  
            , <&pro_micro 16 (GPIO_ACTIVE_LOW | GPIO_PULL_UP)>   // left
            , <&pro_micro 10 (GPIO_ACTIVE_LOW | GPIO_PULL_UP)>   // right
            , <&pro_micro 6 (GPIO_ACTIVE_LOW | GPIO_PULL_UP)>    // center
            ;
    };
};
