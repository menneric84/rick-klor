## config/Kconfig
```kconfig
# Trackball Kconfig for ZMK v0.3
rsource "drivers/input/pimoroni_trackball/Kconfig"
```

## config/boards/shields/rickKlor/Kconfig.defconfig
```kconfig
if RICK_KLOR_LEFT

config ZMK_KEYBOARD_NAME
    default "Rick"

config ZMK_SPLIT_ROLE_CENTRAL
    default y

endif

if RICK_KLOR_LEFT || RICK_KLOR_RIGHT

config ZMK_SPLIT
    default y


endif
```

## config/boards/shields/rickKlor/Kconfig.shield
```kconfig
config SHIELD_RICK_KLOR_LEFT
    def_bool $(shields_list_contains,rickKlorLeft)

config SHIELD_RICK_KLOR_RIGHT
    def_bool $(shields_list_contains,rickKlorRight)
```

## config/drivers/input/pimoroni_trackball/Kconfig
```kconfig
config PIMORONI_TRACKBALL
    bool "Pimoroni Trackball input device"
    default n
    depends on I2C
    select INPUT
    help
      Enable support for the Pimoroni trackball input device.
```

## config/drivers/sensor/pimoroni_trackball/Kconfig
```kconfig
config PIMORONI_TRACKBALL
    bool "Pimoroni Trackball sensor"
    default y
    depends on I2C
    select SENSOR
    help
      Enable support for the Pimoroni trackball sensor.
```

## config/dts/bindings/input/pimoroni,trackball.yaml
```yaml
# Copyright (c) 2023-2025 The ZMK Contributors
# SPDX-License-Identifier: MIT

description: Pimoroni Trackball (PIM447) I2C input device
compatible: "pimoroni,trackball"

include: [i2c-device.yaml]

properties:
  reg:
    required: true
    
  label:
    required: false
    
  poll_period_ms:
    type: int
    default: 10
    description: Polling period in milliseconds
    
  status:
    required: false
```

## config/dts/bindings/sensor/pimoroni,trackball.yaml
```yaml
# Copyright (c) 2023-2025 The ZMK Contributors
# SPDX-License-Identifier: MIT

description: Pimoroni Trackball (PIM447) I2C sensor
compatible: "pimoroni,trackball"

include: [sensor-device.yaml, i2c-device.yaml]

properties:
  reg:
    required: true
    
  label:
    required: false
```
